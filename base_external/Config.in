## base_external/Config.in
```kconfig
menu "External options"
source "$BR2_EXTERNAL_AESD_PATH/package/Config.in"
endmenu
```

## base_external/package/ldd/Config.in
```kconfig
config BR2_PACKAGE_LDD
    bool "ldd"
    help
      Build and install LDD3 example kernel modules (misc-modules, scull, faulty)
```
